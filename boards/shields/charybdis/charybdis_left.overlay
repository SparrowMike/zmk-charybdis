#include "charybdis.dtsi"
#include "charybdis_led.dtsi"

&led_strip {
	chain-length = <46>;
};

&kscan0 {
	compatible = "zmk,kscan-gpio-matrix";

	col-gpios
		= <&pro_micro 19 (GPIO_ACTIVE_HIGH | GPIO_PULL_DOWN)>
		, <&pro_micro 20 (GPIO_ACTIVE_HIGH | GPIO_PULL_DOWN)>
		, <&pro_micro 10 (GPIO_ACTIVE_HIGH | GPIO_PULL_DOWN)>
		, <&pro_micro 6 (GPIO_ACTIVE_HIGH | GPIO_PULL_DOWN)>
		, <&pro_micro 7 (GPIO_ACTIVE_HIGH | GPIO_PULL_DOWN)>
		, <&pro_micro 8 (GPIO_ACTIVE_HIGH | GPIO_PULL_DOWN)>
		;

	row-gpios
		= <&pro_micro 18 GPIO_ACTIVE_HIGH>
		, <&pro_micro 5 GPIO_ACTIVE_HIGH>
		, <&pro_micro 4 GPIO_ACTIVE_HIGH>
		, <&pro_micro 9 GPIO_ACTIVE_HIGH>
		;
};

// INFO: uncomment for dual trackball
// NOTE: Dual trackball uses right-side PCB pattern with swapped switches.
// You MUST also select the swapped transform by adding this to your overlay:
//
// &default_phy_layout {
//     transform = <&five_column_transform_swapped>;
// };
//
// Or add to the chosen node:
// chosen {
//     zmk,matrix-transform = &five_column_transform_swapped;
// };
//
// &spi0 {
//     status = "okay";
// };
//
// &trackball_split {
//     status = "disabled";
// };
//
// &trackball_left_split {
//     device = <&trackball>;
// };
