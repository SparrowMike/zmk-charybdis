/ {
    encoder: encoder {
        compatible = "alps,ec11";

        a-gpios = <&gpio0 17 (GPIO_ACTIVE_HIGH | GPIO_PULL_UP)>;
        b-gpios = <&gpio0 8 (GPIO_ACTIVE_HIGH | GPIO_PULL_UP)>;
        steps = <80>; // Total quadrature state transitions per rotation (X2 encoding: typical EC11 = 20 PPR × 4 = 80)
        status = "disabled";
    };

    kscan_direct: kscan_direct {
        compatible = "zmk,kscan-gpio-direct";
        input-gpios = <&gpio0 20 (GPIO_ACTIVE_LOW | GPIO_PULL_UP)>;
        status = "disabled";
    };

    sensors: sensors {
        compatible = "zmk,keymap-sensors";
        sensors = <&encoder>;
        triggers-per-rotation = <20>; // Actions per rotation (sensitivity): <20>=1 per detent, <10>=half speed, <5>=quarter speed
    };
};
